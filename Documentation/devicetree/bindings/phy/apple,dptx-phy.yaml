## Documentation/devicetree/bindings/phy/apple,dptx-phy.yaml
```yaml
# SPDX-License-Identifier: (GPL-2.0-only OR BSD-2-Clause)
%YAML 1.2
---
$id: http://devicetree.org/schemas/phy/apple,dptx-phy.yaml#
$schema: http://devicetree.org/meta-schemas/core.yaml#

title: Apple DisplayPort transmitter PHY

maintainers:
  - Ryan Murray <81541646+RyanTheTide@users.noreply.github.com>

description: |
  Hardware resources of the Apple Silicon DisplayPort transmitter PHY.
  Register windows are listed in hardware resource order; firmware
  configuration and tuning data are supplied by the boot firmware rather
  than this binding.

select:
  properties:
    compatible:
      contains:
        enum:
          - apple,t8122-dptx-phy
  required:
    - compatible

properties:
  compatible:
    items:
      - enum:
          - apple,t8122-dptx-phy
      - const: apple,dptx-phy

  reg:
    minItems: 2
    maxItems: 2

  reg-names:
    items:
      - const: core
      - const: dptx

  power-domains:
    maxItems: 1

  '#phy-cells':
    const: 0

required:
  - compatible
  - reg
  - reg-names
  - power-domains
  - '#phy-cells'

additionalProperties: false
```
