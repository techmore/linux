// SPDX-License-Identifier: GPL-2.0+ OR MIT
/*
 * TEST ONLY - not for upstream.
 *
 * The U1 tree with the G16 GPU off, for a boot with no GPU variable. The
 * gpu alias is kept: the loader still reserves the GPU's inherited memory
 * (conservative), but no driver binds the disabled node.
 */

#include "t8132-j773g-u1.dts"

/ {
	model = "Apple Mac mini (M4, 2024) [U1 TEST ONLY, no GPU]";
};

&gpu {
	status = "disabled";
};

&agx_mbox {
	status = "disabled";
};
